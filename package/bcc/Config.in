## package/bcc/Config.in
```kconfig
config BR2_PACKAGE_BCC
	bool "bcc"
	depends on BR2_aarch64 || BR2_aarch64_be || BR2_x86_64
	depends on BR2_INSTALL_LIBSTDCPP
	depends on (BR2_TOOLCHAIN_USES_GLIBC && (BR2_aarch64 || BR2_aarch64_be)) || (!BR2_aarch64 && !BR2_aarch64_be)
	depends on BR2_PACKAGE_ELFUTILS
	depends on BR2_PACKAGE_PYTHON || BR2_PACKAGE_PYTHON3
	depends on BR2_PACKAGE_CLANG
	depends on BR2_PACKAGE_LLVM
	depends on BR2_PACKAGE_LLVM_BPF
	select BR2_PACKAGE_ZLIB
	select BR2_PACKAGE_TAR
	help
	  BPF Compiler Collection

	  BCC is a toolkit for creating efficient kernel tracing and
	  manipulation programs, and includes several useful tools and
	  examples.

	  BCC makes BPF programs easier to write, with kernel
	  instrumentation in C (and includes a C wrapper around LLVM),
	  and front-ends in Python and lua. It is suited for many tasks,
	  including performance analysis and network traffic control.

	  https://www.github.com/iovisor/bcc

comment "bcc supported on aarch64 and x86_64"
	depends on !(BR2_aarch64 || BR2_aarch64_be || BR2_x86_64)

comment "bcc requires glibc on aarch64"
	depends on !BR2_TOOLCHAIN_USES_GLIBC && (BR2_aarch64 || BR2_aarch64_be)

comment "bcc needs a toolchain w/ C++, elfutils, python, clang, llvm, llvm-bpf"
	depends on !BR2_INSTALL_LIBSTDCPP || !BR2_PACKAGE_ELFUTILS || (!BR2_PACKAGE_PYTHON && !BR2_PACKAGE_PYTHON3) || !BR2_PACKAGE_CLANG || !BR2_PACKAGE_LLVM || !BR2_PACKAGE_LLVM_BPF
```

## package/bpftrace/Config.in
```kconfig
config BR2_PACKAGE_BPFTRACE
	bool "bpftrace"
	depends on BR2_aarch64 || BR2_aarch64_be || BR2_x86_64
	depends on BR2_PACKAGE_BCC
	depends on BR2_PACKAGE_LLVM_RTTI
	help
	  BPFTrace

	  bpftrace is a high-level tracing language for Linux enhanced
	  Berkeley Packet Filter (eBPF) available in recent Linux
	  kernels (4.x).

	  bpftrace uses LLVM as a backend to compile scripts to
	  BPF-bytecode and makes use of BCC for interacting with the
	  Linux BPF system, as well as existing Linux tracing
	  capabilities: kernel dynamic tracing (kprobes), user-level
	  dynamic tracing (uprobes), and tracepoints. The bpftrace
	  language is inspired by awk and C, and predecessor tracers
	  such as DTrace and SystemTap.

	  https://www.github.com/iovisor/bpftrace

comment "bpftrace supported on aarch64 and x86_64"
	depends on !(BR2_aarch64 || BR2_aarch64_be || BR2_x86_64)

comment "bpftrace needs bcc, llvm-rtti"
	depends on !BR2_PACKAGE_BCC || !BR2_PACKAGE_LLVM_RTTI
```
